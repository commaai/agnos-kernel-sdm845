## drivers/comma/panda/Kconfig
```kconfig
config PANDA_SPI
    tristate "Panda SPI driver"
    depends on SPI
    default n
    help
      Custom SPI driver for communicating with Panda board.
```

## drivers/fan/Kconfig
```kconfig
config KERNEL_FAN
	tristate "Enable Fan Driver Support"
	help
	  Add support for fan driver.
```

## drivers/gpu/drm/bridge/lt8912/Kconfig
```kconfig
config DRM_I2C_LT8912
	bool "LT8912 encoder"
	select DRM_MIPI_DSI
	default n
	help
	  Support for the Lontium Devices LT8912 DSI to HDMI encoder.
```

## drivers/gpu/drm/bridge/lt9611/Kconfig
```kconfig
config DRM_I2C_LT9611
	bool "LT9611 encoder"
	select DRM_MIPI_DSI
	default n
	help
	  Support for the Lontium Devices LT9611 DSI to HDMI encoder.
```

## drivers/gpu/drm/client/Kconfig
```kconfig
menu "DRM Clients"
	depends on DRM

config DRM_CLIENT_BOOTSPLASH
	tristate "DRM Bootsplash"
	help
	  DRM Bootsplash

endmenu
```
