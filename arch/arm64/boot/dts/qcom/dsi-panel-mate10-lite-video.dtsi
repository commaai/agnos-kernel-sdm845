/* Copyright (c) 2015, The Linux Foundation. All rights reserved.
 * Copyright (C) 2022 comma.ai
 *
 * This program is free software; you can redistribute it and/or modify
 * it under the terms of the GNU General Public License version 2 and
 * only version 2 as published by the Free Software Foundation.
 *
 * This program is distributed in the hope that it will be useful,
 * but WITHOUT ANY WARRANTY; without even the implied warranty of
 * MERCHANTABILITY or FITNESS FOR A PARTICULAR PURPOSE.  See the
 * GNU General Public License for more details.
 */

/*---------------------------------------------------------------------------
 * This file is autogenerated file using gcdb parser. Please do not edit it.
 * Update input XML file to add a new entry or update variable in this file
 * VERSION = "1.0"
 *---------------------------------------------------------------------------*/
&mdss_mdp {
	dsi_mate10_lite_video: qcom,mdss_dsi_mate10_lite_video {
		qcom,mdss-dsi-panel-name = "mate10 lite lcd dsi panel";
		qcom,mdss-dsi-panel-id = <0>;
		qcom,mdss-dsi-panel-model = "MATE10 LITE LCD PANEL";
		qcom,mdss-dsi-panel-type = "dsi_video_mode";
		qcom,mdss-dsi-virtual-channel-id = <0>;
		qcom,mdss-dsi-stream = <0>;
		qcom,mdss-dsi-bpp = <24>;
		qcom,mdss-dsi-underflow-color = <0xff>;
		qcom,mdss-dsi-border-color = <0>;
		qcom,mdss-dsi-traffic-mode = "burst_mode";
		qcom,mdss-dsi-bllp-eof-power-mode;
		qcom,mdss-dsi-bllp-power-mode;
 		qcom,mdss-dsi-lp11-init;
		qcom,mdss-dsi-lane-0-state;
		qcom,mdss-dsi-lane-1-state;
		qcom,mdss-dsi-lane-2-state;
		qcom,mdss-dsi-lane-3-state;
		// qcom,mdss-dsi-t-clk-post = <0x0e>;
		// qcom,mdss-dsi-t-clk-pre = <0x31>;
    qcom,mdss-dsi-bl-min-level = <0>;
		qcom,mdss-dsi-bl-max-level = <255>;
		qcom,mdss-brightness-max-level = <255>;
		qcom,mdss-dsi-dma-trigger = "trigger_sw";
		qcom,mdss-dsi-mdp-trigger = "none";
		qcom,mdss-dsi-bl-pmic-control-type = "bl_ctrl_dcs";
		qcom,mdss-dsi-reset-sequence = <1 1>, <0 1>, <1 10>;
		qcom,mdss-pan-physical-width-dimension = <67>;
		qcom,mdss-pan-physical-height-dimension = <135>;
		qcom,mdss-dsi-te-pin-select = <1>;
		qcom,mdss-dsi-wr-mem-start = <0x2c>;
		qcom,mdss-dsi-wr-mem-continue = <0x3c>;
		qcom,mdss-dsi-te-dcs-command = <1>;
		qcom,mdss-dsi-te-check-enable;
		qcom,mdss-dsi-te-using-te-pin;
		qcom,mdss-dsi-tx-eot-append;
		// qcom,mdss-dsi-panel-hdr-enabled;
		// qcom,mdss-dsi-panel-hdr-color-primaries = <14500 15500 32000
		// 	17000 15500 30000 8000 3000>;
		qcom,mdss-dsi-panel-peak-brightness = <4300000>; // TODO: verify
		qcom,mdss-dsi-panel-blackness-level = <3230>; // TODO: verify
		// qcom,mdss-dsi-on-command-tuning;
		// qcom,dispparam-enabled;
		/* qcom,esd-err-irq-gpio = <&tlmm 52 0>; */
		qcom,ulps-enabled;
 		qcom,suspend-ulps-enabled;
		qcom,panel-allow-phy-poweroff;
		qcom,mdss-dsi-display-timings {
			timing@0{
				qcom,mdss-dsi-panel-width = <1080>;
				qcom,mdss-dsi-panel-height = <2160>;
				qcom,mdss-dsi-h-front-porch = <29>;
				qcom,mdss-dsi-h-back-porch = <90>;
				qcom,mdss-dsi-h-pulse-width = <6>;
				qcom,mdss-dsi-h-sync-skew = <0>;
				qcom,mdss-dsi-v-back-porch = <26>;
				qcom,mdss-dsi-v-front-porch = <16>;
				qcom,mdss-dsi-v-pulse-width = <10>;
				qcom,mdss-dsi-h-left-border = <0>;
				qcom,mdss-dsi-h-right-border = <0>;
				qcom,mdss-dsi-v-top-border = <0>;
				qcom,mdss-dsi-v-bottom-border = <0>;
				qcom,mdss-dsi-panel-framerate = <60>;
				qcom,mdss-dsi-on-command = [
					29 01 00 00 0a 00 02 00 00
					29 01 00 00 0a 00 04 ff 19 11 01
					29 01 00 00 0a 00 02 00 80
					29 01 00 00 0a 00 03 ff 19 11
					29 01 00 00 0a 00 02 00 92
					29 01 00 00 0a 00 03 b3 18 06
					29 01 00 00 0a 00 02 00 b0
					29 01 00 00 0a 00 05 b3 04 38 08 70
					29 01 00 00 0a 00 02 00 B0
					29 01 00 00 0a 00 02 CA 00
					29 01 00 00 0a 00 02 00 B2
					29 01 00 00 0a 00 02 CA 0A
					29 01 00 00 0D 00 02 00 A0
					29 01 00 00 0E 00 04 CA 0F 0F 0F
					29 01 00 00 0a 00 02 00 94
					29 01 00 00 0a 00 08 c0 00 01 06 00 01 15 05
					29 01 00 00 0a 00 02 00 80
					29 01 00 00 0a 00 08 c5 55 05 11 9b ab 96 aa
					29 01 00 00 0a 00 02 00 90
					29 01 00 00 0a 00 06 c5 45 a0 33 65 80
					29 01 00 00 0a 00 02 00 a0
					29 01 00 00 0a 00 05 c5 98 a8 04 00
					29 01 00 00 0a 00 02 00 81
					29 01 00 00 0a 00 04 c1 90 C0 F0
					29 01 00 00 0a 00 02 00 80
					29 01 00 00 0a 00 09 c3 00 00 00 00 00 00 22 22
					29 01 00 00 0a 00 02 00 90
					29 01 00 00 0a 00 05 c3 00 00 00 00
					29 01 00 00 0a 00 02 00 00
					29 01 00 00 0a 00 03 d8 2b 2b
					29 01 00 00 0a 00 02 00 89
					29 01 00 00 0a 00 03 c0 10 14
					29 01 00 00 0a 00 02 00 90
					29 01 00 00 0a 00 04 cb 00 00 0C
					29 01 00 00 0a 00 02 00 c0
					29 01 00 00 0a 00 0d cb 34 34 34 f4 30 30 34 30 34 30 30 30
					29 01 00 00 0a 00 02 00 f0
					29 01 00 00 0a 00 05 cb ff 30 33 80
					29 01 00 00 0D 00 02 00 80
					29 01 00 00 16 00 0D CA E3 D3 C3 B6 AC A3 9C 96 90 8C 87 84
					29 01 00 00 0D 00 02 00 90
					29 01 00 00 13 00 0A CA FE FF 13 FE FF 13 F9 FF 47
					29 01 00 00 0D 00 02 00 A0
					29 01 00 00 16 00 0D D6 11 0A 0F 0F 07 08 0F 0B 08 11 12 13
					29 01 00 00 0D 00 02 00 B0
					29 01 00 00 16 00 0D D6 8E 8D 93 93 8E 80 80 76 51 54 6C A0
					29 01 00 00 0D 00 02 00 C0
					29 01 00 00 16 00 0D D6 93 8F 8C 99 97 93 80 94 66 68 70 87
					29 01 00 00 0D 00 02 00 D0
					29 01 00 00 16 00 0D D6 84 83 85 83 80 80 80 80 84 80 80 7F
					29 01 00 00 0a 00 02 00 00
					29 01 00 00 0a 00 04 FF FF FF FF
					29 01 00 00 0a 00 02 00 00
					29 01 00 00 0a 00 04 FF 10 80 01
					29 01 00 00 0a 00 02 00 80
					29 01 00 00 0a 00 03 FF 10 80
					29 01 00 00 0a 00 02 00 A0
					29 01 00 00 0a 00 05 D2 02 02 0A 00
					29 01 00 00 0a 00 03 51 00 00
					29 01 00 00 0D 00 03 5E 28 00
					29 01 00 00 0D 00 03 90 80 44
					15 01 00 00 0D 00 02 91 80
					15 01 00 00 0a 00 02 53 24
					15 01 00 00 0a 00 02 55 01
					05 01 00 00 64 00 02 11 00
					05 01 00 00 00 00 02 29 00
				];
				qcom,mdss-dsi-off-command = [
					05 01 00 00 14 00 02 28 00
					05 01 00 00 78 00 02 10 00
					29 01 00 00 0a 00 02 00 00
					29 01 00 00 0a 00 04 ff 19 11 01
					29 01 00 00 0a 00 02 00 80
					29 01 00 00 0a 00 03 ff 19 11
					29 01 00 00 0a 00 02 00 90
					29 01 00 00 0a 00 02 B3 34
				];
				qcom,mdss-dsi-on-command-state = "dsi_lp_mode";
				qcom,mdss-dsi-off-command-state = "dsi_lp_mode";
				qcom,mdss-dsi-doze-hbm-command = [
					39 01 00 00 00 00 03 51 00 01
					39 01 00 00 01 00 02 53 22];
				qcom,mdss-dsi-doze-lbm-command = [
					39 01 00 00 00 00 03 51 00 01
					39 01 00 00 01 00 02 53 23];
				qcom,mdss-dsi-nolp-command = [
					39 01 00 00 00 00 02 53 25];
				qcom,mdss-dsi-doze-hbm-command-state = "dsi_lp_mode";
				qcom,mdss-dsi-doze-lbm-command-state = "dsi_lp_mode";
				qcom,mdss-dsi-nolp-command-state = "dsi_lp_mode";
				qcom,mdss-dsi-dispparam-acl-off-command = [39 01 00 00 00 00 02 55 00];
				qcom,mdss-dsi-dispparam-acl-off-command-state = "dsi_lp_mode";
				qcom,mdss-dsi-dispparam-acl-l1-command = [39 01 00 00 00 00 02 55 01];/*50%*/
				qcom,mdss-dsi-dispparam-acl-l1-command-state = "dsi_lp_mode";
				qcom,mdss-dsi-dispparam-acl-l2-command = [39 01 00 00 00 00 02 55 02];/*40%*/
				qcom,mdss-dsi-dispparam-acl-l2-command-state = "dsi_lp_mode";
				qcom,mdss-dsi-dispparam-acl-l3-command = [39 01 00 00 00 00 02 55 03];/*30%*/
				qcom,mdss-dsi-dispparam-acl-l3-command-state = "dsi_lp_mode";
				qcom,mdss-dsi-dispparam-hbm-off-command = [39 01 00 00 00 00 02 53 25];
				qcom,mdss-dsi-dispparam-hbm-off-command-state = "dsi_lp_mode";
				qcom,mdss-dsi-dispparam-hbm-on-command = [39 01 00 00 00 00 02 53 e0];
				qcom,mdss-dsi-dispparam-hbm-on-command-state = "dsi_lp_mode";
				qcom,mdss-dsi-h-sync-pulse = <0>;
			};
		};
	};
};
