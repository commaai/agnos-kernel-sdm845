/* Copyright (c) 2017, The Linux Foundation. All rights reserved.
 *
 * This program is free software; you can redistribute it and/or modify
 * it under the terms of the GNU General Public License version 2 and
 * only version 2 as published by the Free Software Foundation.
 *
 * This program is distributed in the hope that it will be useful,
 * but WITHOUT ANY WARRANTY; without even the implied warranty of
 * MERCHANTABILITY or FITNESS FOR A PARTICULAR PURPOSE.  See the
 * GNU General Public License for more details.
 */


/dts-v1/;

#include <dt-bindings/clock/qcom,gcc-sdm845.h>
#include <dt-bindings/clock/qcom,camcc-sdm845.h>
#include <dt-bindings/clock/qcom,dispcc-sdm845.h>
#include <dt-bindings/clock/qcom,rpmh.h>
#include <dt-bindings/interrupt-controller/arm-gic.h>

#include "sda845-v2.1.dtsi"

#include "comma_common.dtsi"

/* touch panel I2C, /dev/i2c-2 */
&qupv3_se5_i2c {
  status = "ok";
  qcom,clk-freq-out = <100000>;
};

/* No screen for now */
&mdss_mdp {
	status = "disabled";
};

&sde_wb {
	status = "disabled";
};


/* Board definition */
/ {
	model = "comma 3X";
	compatible = "qcom,sda845-mtp", "qcom,sda845", "qcom,mtp";
	qcom,msm-id = <341 0x20001>;
	qcom,board-id = <0x21 0>;
};
