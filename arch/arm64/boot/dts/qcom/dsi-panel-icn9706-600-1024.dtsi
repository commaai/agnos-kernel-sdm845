/* Copyright (c) 2018, The Linux Foundation. All rights reserved.
 *
 * This program is free software; you can redistribute it and/or modify
 * it under the terms of the GNU General Public License version 2 and
 * only version 2 as published by the Free Software Foundation.
 *
 * This program is distributed in the hope that it will be useful,
 * but WITHOUT ANY WARRANTY; without even the implied warranty of
 * MERCHANTABILITY or FITNESS FOR A PARTICULAR PURPOSE.  See the
 * GNU General Public License for more details.
 */


&mdss_mdp {
	dsi_icn9706_600_1024_vid: qcom,dsi_icn9706_600_1024_vid {
    qcom,mdss-dsi-panel-name = "icn9706 video mode dsi panel";
    qcom,mdss-dsi-panel-controller = <&mdss_dsi0>;
    qcom,mdss-dsi-panel-id = <0>;
    qcom,mdss-dsi-panel-width = <1024>;
    qcom,mdss-dsi-panel-height = <600>;
		qcom,mdss-dsi-panel-type = "dsi_video_mode";
    qcom,mdss-dsi-virtual-channel-id = <0>;
    qcom,mdss-dsi-stream = <0>;
    qcom,mdss-dsi-bpp = <24>;
		qcom,mdss-dsi-underflow-color = <0xff>;
		qcom,mdss-dsi-border-color = <0>;
    qcom,mdss-dsi-traffic-mode = "burst_mode";
		qcom,mdss-dsi-bllp-eof-power-mode;
		qcom,mdss-dsi-bllp-power-mode;
    qcom,mdss-dsi-lane-0-state;
		qcom,mdss-dsi-lane-1-state;
		qcom,mdss-dsi-lane-2-state;
		qcom,mdss-dsi-lane-3-state;
    qcom,mdss-dsi-t-clk-post = <0x20>;
		qcom,mdss-dsi-t-clk-pre = <0x30>;
		qcom,mdss-dsi-bl-min-level = <1>;
		qcom,mdss-dsi-bl-max-level = <255>;
    qcom,mdss-brightness-max-level = <255>;
		qcom,mdss-dsi-dma-trigger = "trigger_sw";
		qcom,mdss-dsi-mdp-trigger = "none";
    qcom,mdss-dsi-reset-sequence = <1 2>, <0 20>, <1 50>;
		qcom,mdss-dsi-tx-eot-append;
		qcom,mdss-pan-physical-width-dimension = <163>;
		qcom,mdss-pan-physical-height-dimension = <95>;
		// qcom,esd-check-enabled;
		qcom,mdss-dsi-panel-status-check-mode = "bta_check";
		qcom,mdss-dsi-bl-pmic-control-type = "bl_ctrl_dcs";

    qcom,mdss-dsi-te-using-wd;
    qcom,mdss-dsi-te-pin-select = <0>;

    qcom,mdss-dsi-panel-framerate = <60>;

    qcom,mdss-dsi-display-timings {
			timing@0{
        qcom,mdss-dsi-panel-width = <1024>;
        qcom,mdss-dsi-panel-height = <600>;
        qcom,mdss-dsi-h-front-porch = <16>;
        qcom,mdss-dsi-h-back-porch = <20>;
        qcom,mdss-dsi-h-pulse-width = <4>;
        qcom,mdss-dsi-h-sync-skew = <0>;
        qcom,mdss-dsi-v-back-porch = <12>;
        qcom,mdss-dsi-v-front-porch = <16>;
        qcom,mdss-dsi-v-pulse-width = <4>;
        qcom,mdss-dsi-h-left-border = <0>;
        qcom,mdss-dsi-h-right-border = <0>;
        qcom,mdss-dsi-v-top-border = <0>;
        qcom,mdss-dsi-v-bottom-border = <0>;
        qcom,mdss-dsi-panel-framerate = <60>;

        qcom,mdss-dsi-te-using-wd;
        qcom,mdss-dsi-te-pin-select = <0>;

        // qcom,mdss-dsi-on-command = [
        //   // SW reset
        //   39 01 00 00 64 00 02 01 00

        //   // Enable L2 registers (passwd)
        //   39 01 00 00 00 00 03 f0 5a 5a
        //   39 01 00 00 00 00 03 f1 5a 5a
        //   39 01 00 00 00 00 03 f0 b4 4b

        //   // Set VCOM voltage
        //   39 01 00 00 00 00 03 b6 10 10

        //   // CGOUTR control?
        //   39 01 00 00 00 00 15 b4 0a 08 12 10 0e 0c 00 00 00 03 00 03 03 03 03 03 03 03 04 06

        //   // CGOUTL control?
        //   39 01 00 00 00 00 15 b3 0b 09 13 11 0f 0d 00 00 00 03 00 03 03 03 03 03 03 03 05 07

        //   // no clue
        //   39 01 00 00 00 00 0d b0 54 32 23 45 44 44 44 44	60 01 60 01
        //   39 01 00 00 00 00 09 b1 32 84 02 83 15 01 57 01
        //   39 01 00 00 00 00 02 b2 33

        //   // PWRCON reg set
        //   39 01 00 00 00 00 07 bd 54 14 6a 6a 20 19

        //   // PWRCON_SEQ reg set
        //   39 01 00 00 00 00 12 b7 01 01 09 11 0d 15 19 0d	21 1d 00 00 20 00 02 ff 3c

        //   // PWRCON_CLK reg set
        //   39 01 00 00 00 00 06 b8 23 01 30 34 53

        //   // PWRCON_BAT reg set
        //   39 01 00 00 00 00 05 b9 a1 2c ff c4

        //   // PWRCON_MODE reg set
        //   39 01 00 00 00 00 03 ba 88 23

        //   // TCON set (porch settings)
        //   39 01 00 00 00 00 07 c1 16 16 04 0c 10 04

        //   // TCON2 (display resolution)
        //   39 01 00 00 00 00 03 c2 91 00
        //   39 01 00 00 00 00 03 c2 11 00

        //   // TCON3 (blanking frame)
        //   39 01 00 00 00 00 04 c3 22 31 04

        //   // SRCCON (source control, mainly the panel type)
        //   39 01 00 00 00 00 06 c7 05 23 6b 41 00

        //   // SET_GAMMA
        //   39 01 00 00 00 00 27 c8 7c 54 3d 2d 26 16 1b 08	25 28 2d 4f 3e 48 3d 3d 35 25 06 7c 54 3d 2d 26 16 1b 08 25 28 2d 4f 3e 48 3d 3d 35 25 06

        //   // SRC_TIM
        //   39 01 00 00 00 00 09 c6 00 00 68 00 00 60 36 00

        //   // SLEEP disable
        //   05 01 00 00 64 00 02 11 00

        //   // DISP on
        //   05 01 00 00 32 00 02 29 00
        // ];

        // From BOE
        qcom,mdss-dsi-on-command = [
          39 01 00 00 C8 00 02 01 00

          39 01 00 00 00 00 03 f0 5a 5a
          39 01 00 00 00 00 03 f1 a5 a5

          39 01 00 00 00 00 0d b0 21 21 21 21 22 22 22 22 78 00 76 20
          39 01 00 00 00 00 09 b1 12 44 02 05 78 20 76 20
          39 01 00 00 00 00 07 b3 0D 0D 0F 0F 05 05
          39 01 00 00 00 00 07 b4 0C 0C 0E 0E 04 04
          39 01 00 00 00 00 12 b7 01 41 09 11 0D 15 19 1D 21 1D 00 00 20 00 02 FF 3C
          39 01 00 00 00 00 06 b8 24 01 A1 34 53
          39 01 00 00 00 00 03 ba 88 63
          39 01 00 00 00 00 08 bd 4E 0E 42 42 20 1E 00

          39 01 00 00 00 00 07 c1 0C 10 04 0C 10 04
          39 01 00 00 00 00 03 c2 81 10
          39 01 00 00 00 00 04 c3 22 31 04
          39 01 00 00 00 00 09 c6 00 00 FF 00 00 FF 00 00
          39 01 00 00 00 00 06 c7 36 22 6B 41 04
          39 01 00 00 00 00 27 c8 7C 6B 5E 53 51 44 49 32 4C 4B 4B 69 57 5F 51 4C 40 30 06 7C 6B 5E 53 51 44 49 32 4C 4B 4B 69 57 5F 51 4C 40 30 06

          39 01 00 00 00 00 05 d0 07 FF FF FF
          39 01 00 00 00 00 02 d2 63
          39 01 00 00 00 00 07 d4 00 01 00 0E 04 34

          39 01 00 00 00 00 06 e0 32 03 20 00 FF

          39 01 00 00 00 00 03 f0 A5 A5
          39 01 00 00 00 00 03 f1 5A 5A

          39 01 00 00 00 00 02 35 00

          05 01 00 00 78 00 02 11 00
          05 01 00 00 32 00 02 29 00
        ];

        // qcom,mdss-dsi-on-command = [
        //   39 01 00 00 64 00 02 01 00
        //   05 01 00 00 64 00 02 11 00
        //   05 01 00 00 32 00 02 29 00
        // ];

        qcom,mdss-dsi-off-command = [
          05 01 00 00 32 00 02 28 00
          05 01 00 00 32 00 02 10 00
        ];

        qcom,mdss-dsi-on-command-state = "dsi_lp_mode";
		    qcom,mdss-dsi-off-command-state = "dsi_lp_mode";

      };
    };
  };
};



// &mdss_mdp {
// 	dsi_icn9706_600_1024_vid: qcom,dsi_icn9706_600_1024_vid {
// 		qcom,mdss-dsi-panel-name = "icn9706 video mode dsi panel";
// 		qcom,mdss-dsi-panel-controller = <&mdss_dsi0>;
// 		qcom,mdss-dsi-panel-destination = "display_1";
// 		qcom,mdss-dsi-panel-type = "dsi_video_mode";
// 		qcom,mdss-dsi-panel-framerate = <60>;
// 		qcom,mdss-dsi-virtual-channel-id = <0>;
// 		qcom,mdss-dsi-stream = <0>;
// 		qcom,mdss-dsi-panel-width = <600>;
// 		qcom,mdss-dsi-panel-height = <1024>;
// 		qcom,mdss-dsi-h-front-porch = <84>;
// 		qcom,mdss-dsi-h-back-porch = <84>;
// 		qcom,mdss-dsi-h-pulse-width = <24>;
// 		qcom,mdss-dsi-h-sync-skew = <0>;
// 		qcom,mdss-dsi-v-back-porch = <20>;
// 		qcom,mdss-dsi-v-front-porch = <24>;
// 		qcom,mdss-dsi-v-pulse-width = <8>;
// 		qcom,mdss-dsi-h-left-border = <0>;
// 		qcom,mdss-dsi-h-right-border = <0>;
// 		qcom,mdss-dsi-v-top-border = <0>;
// 		qcom,mdss-dsi-v-bottom-border = <0>;
// 		qcom,mdss-dsi-bpp = <24>;
// 		qcom,mdss-dsi-underflow-color = <0xff>;
// 		qcom,mdss-dsi-border-color = <0>;
// 		qcom,mdss-dsi-h-sync-pulse = <1>;
// 		qcom,mdss-dsi-traffic-mode = "burst_mode";
// 		qcom,mdss-dsi-bllp-eof-power-mode;
// 		qcom,mdss-dsi-bllp-power-mode;
// 		qcom,mdss-dsi-lane-map = "lane_map_0123";
// 		qcom,mdss-dsi-lane-0-state;
// 		qcom,mdss-dsi-lane-1-state;
// 		qcom,mdss-dsi-lane-2-state;
// 		qcom,mdss-dsi-lane-3-state;
// 		qcom,mdss-dsi-panel-timings = [8b 1e 14 00 44 48 18 22 19 03 04 00];
// 		qcom,mdss-dsi-t-clk-post = <0x04>;
// 		qcom,mdss-dsi-t-clk-pre = <0x1c>;
// 		qcom,mdss-dsi-bl-min-level = <1>;
// 		qcom,mdss-dsi-bl-max-level = <4095>;
// 		qcom,mdss-dsi-dma-trigger = "trigger_sw";
// 		qcom,mdss-dsi-mdp-trigger = "none";
// 		qcom,mdss-dsi-on-command = [
//       39 01 00 00 64 00 02 01 00
// 			39 01 00 00 00 00 03 f0 5a 5a
// 			39 01 00 00 00 00 03 f1 5a 5a
// 			39 01 00 00 00 00 03 f0 b4 4b
// 			39 01 00 00 00 00 03 b6 10 10
// 			39 01 00 00 00 00 15 b4 0a 08 12 10 0e 0c 00 00 00 03 00 03 03 03 03 03 03 03 04 06
// 			39 01 00 00 00 00 15 b3 0b 09 13 11 0f 0d 00 00 00 03 00 03 03 03 03 03 03 03 05 07
// 			39 01 00 00 00 00 0d b0 54 32 23 45 44 44 44 44	60 01 60 01
// 			39 01 00 00 00 00 09 b1 32 84 02 83 15 01 57 01
// 			39 01 00 00 00 00 02 b2 33
// 			39 01 00 00 00 00 07 bd 54 14 6a 6a 20 19
// 			39 01 00 00 00 00 12 b7 01 01 09 11 0d 15 19 0d	21 1d 00 00 20 00 02 ff 3c
// 			39 01 00 00 00 00 06 b8 23 01 30 34 53
// 			39 01 00 00 00 00 05 b9 a1 2c ff c4
// 			39 01 00 00 00 00 03 ba 88 23
// 			39 01 00 00 00 00 07 c1 16 16 04 0c 10 04
// 			39 01 00 00 00 00 03 c2 12 68
// 			39 01 00 00 00 00 04 c3 22 31 04
// 			39 01 00 00 00 00 06 c7 05 23 6b 41 00
// 			39 01 00 00 00 00 27 c8 7c 54 3d 2d 26 16 1b 08	25 28 2d 4f 3e 48 3d 3d 35 25 06 7c 54 3d 2d 26 16 1b 08 25 28 2d 4f 3e 48 3d 3d 35 25 06
// 			39 01 00 00 00 00 09 c6 00 00 68 00 00 60 36 00
// 			05 01 00 00 64 00 02 11 00
// 			05 01 00 00 32 00 02 29 00
//     ];

// 		qcom,mdss-dsi-off-command = [
//       05 01 00 00 32 00 02 28 00
// 			05 01 00 00 32 00 02 10 00
//     ];

// 		qcom,mdss-dsi-on-command-state = "dsi_lp_mode";
// 		qcom,mdss-dsi-off-command-state = "dsi_lp_mode";
// 		qcom,esd-check-enabled;
// 		qcom,mdss-dsi-panel-status-check-mode = "bta_check";
// 		qcom,mdss-dsi-bl-pmic-control-type = "bl_ctrl_wled";
// 		qcom,mdss-dsi-reset-sequence = <1 2>, <0 20>, <1 50>;
// 		qcom,mdss-dsi-tx-eot-append;
// 		qcom,mdss-pan-physical-width-dimension = <95>;
// 		qcom,mdss-pan-physical-height-dimension = <163>;
// 	};
// };
